## main/Kconfig.projbuild
```kconfig
menu "BLE USB Dongle"

    config DONGLE_LED_GPIO
        int "Status RGB LED (WS2812) GPIO"
        default 48
        help
            DevKitC-1 v1.0 uses GPIO48, v1.1 uses GPIO38.

    config DONGLE_LED_BRIGHTNESS
        int "Blue level while a BLE device is connected (0-255)"
        range 0 255
        default 4

    config DONGLE_USB_VID
        hex "USB vendor ID"
        default 0x303A

    config DONGLE_USB_PID
        hex "USB product ID"
        default 0x4B42

    config DONGLE_LOG_HCI_DECODE
        bool "Log decoded HCI commands/events/ACL headers"
        default y

    config DONGLE_LOG_HCI_HEX
        bool "Log raw HCI packet hex dumps (very verbose)"
        default y

    config DONGLE_LOG_HEX_MAX_BYTES
        int "Maximum bytes per hex dump"
        default 272
        depends on DONGLE_LOG_HCI_HEX

    config DONGLE_STATS_PERIOD_MS
        int "Statistics log period in ms (0 disables)"
        default 5000

endmenu
```
